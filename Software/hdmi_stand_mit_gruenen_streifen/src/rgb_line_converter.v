// Parallel RGB input -> multi-line buffer -> independent output clock.
//
// Input lines (HSYNC to HSYNC) are written round-robin into an 8-line
// buffer with the source PCLK. The output timing runs freely on its own
// (crystal-derived) clock with a fixed line length; only the vertical
// timing is re-aligned to the source frame start (first line with DE after
// the vertical blanking), so output and source frame rate stay equal. Small
// frequency differences are absorbed by the buffer and by occasionally
// lengthening/shortening the vertical blanking by one line.
//
// VSYNC and HSYNC are generated by the output timing, the VS input is not
// used. Without a source the output keeps running and shows black.

`default_nettype none

module rgb_line_converter #(
	parameter H_ACTIVE       = 800,  // max. pixels stored per line
	parameter V_ACTIVE       = 480,
	parameter HS_ACTIVE_LOW  = 1,    // input and output HSYNC polarity
	parameter VS_ACTIVE_LOW  = 1,    // output VSYNC polarity
	parameter DE_ACTIVE_LOW  = 0,
	parameter SAMPLE_FALLING = 1,    // sample input data on falling PCLK edge
	parameter MIN_LINE       = 256,  // min. input line length (pclk), glitch filter
	parameter MIN_VBLANK     = 4,    // lines without DE before a new frame

	// output timing (output clocks / lines)
	parameter OUT_H_TOTAL    = 1579, // ~ input line duration x output clock
	parameter OUT_HS_WIDTH   = 96,
	parameter OUT_H_START    = 240,  // HSYNC + back porch
	parameter OUT_V_TOTAL    = 525,  // free-running frame length without source
	parameter OUT_VS_LINES   = 3,
	parameter OUT_V_START    = 35,   // VSYNC + back porch
	parameter LAG            = 2     // output lags the source by this many lines
) (
	// input side (source pixel clock domain)
	input  wire        pclk,
	input  wire [23:0] rgb_in,   // {R, G, B}
	input  wire        de_in,
	input  wire        hs_in,

	// output side (output pixel clock domain)
	input  wire        clk_out,
	input  wire        resetn_out,
	output reg  [23:0] rgb_out,  // {R, G, B}
	output reg         de_out,   // active high
	output reg         hs_out,   // polarity HS_ACTIVE_LOW
	output reg         vs_out,   // polarity VS_ACTIVE_LOW
	output reg         resync_toggle  // toggles when the frame phase is corrected
);
	localparam AW = 10;          // 1024 pixel slots per line
	localparam SW = 3;           // 8 lines

	// ------------------------------------------------------------------
	// Input side
	// ------------------------------------------------------------------

	reg [23:0] cap_rgb;
	reg        cap_de, cap_hs;

	generate
		if (SAMPLE_FALLING) begin : g_cap_neg
			always @(negedge pclk)
				{cap_rgb, cap_de, cap_hs} <= {rgb_in, de_in, hs_in};
		end else begin : g_cap_pos
			always @(posedge pclk)
				{cap_rgb, cap_de, cap_hs} <= {rgb_in, de_in, hs_in};
		end
	endgenerate

	// normalize to active high
	reg [23:0] px;
	reg        de = 0, hs = 0, hs_d = 0;

	always @(posedge pclk) begin
		px   <= cap_rgb;
		de   <= cap_de ^ (DE_ACTIVE_LOW != 0);
		hs   <= cap_hs ^ (HS_ACTIVE_LOW != 0);
		hs_d <= hs;
	end

	// HSYNC edges closer than MIN_LINE pclk cycles to the last accepted
	// line start are treated as glitches and ignored
	reg [11:0] in_hcnt = 0;

	wire line_end = hs && !hs_d && in_hcnt >= MIN_LINE;

	always @(posedge pclk)
		if (line_end)
			in_hcnt <= 0;
		else if (!(&in_hcnt))
			in_hcnt <= in_hcnt + 1'b1;

	reg [AW-1:0] wr_x = 0;
	reg [SW-1:0] wr_slot = 0;
	reg          line_valid = 0;
	reg [7:0]    blank_lines = 0;    // consecutive lines without DE
	reg [7:0]    slot_valid = 0;     // slot holds a line with DE

	// frame hand-over: fr_base is stable for a whole frame after fr_toggle
	reg          fr_toggle = 0;
	reg [SW-1:0] fr_base = 0;        // slot of the first active line

	always @(posedge pclk) begin
		if (line_end) begin
			slot_valid[wr_slot] <= line_valid;
			if (line_valid && blank_lines >= MIN_VBLANK) begin
				fr_base   <= wr_slot;
				fr_toggle <= !fr_toggle;
			end
			blank_lines <= line_valid ? 8'd0 :
			               (&blank_lines) ? blank_lines : blank_lines + 1'b1;
			wr_slot    <= wr_slot + 1'b1;
			wr_x       <= 0;
			line_valid <= 0;
		end else if (de && wr_x < H_ACTIVE) begin
			wr_x       <= wr_x + 1'b1;
			line_valid <= 1;
		end
	end

	// line buffer, written with pclk, read with clk_out
	reg [23:0] line_mem [0:(1 << (SW + AW))-1];

	wire we = !line_end && de && wr_x < H_ACTIVE;

	always @(posedge pclk)
		if (we)
			line_mem[{wr_slot, wr_x}] <= px;

	// ------------------------------------------------------------------
	// Output side
	// ------------------------------------------------------------------

	reg [2:0] fr_sync = 0;
	always @(posedge clk_out)
		fr_sync <= {fr_sync[1:0], fr_toggle};

	wire frame_evt = fr_sync[2] ^ fr_sync[1];

	localparam V_JUMP = OUT_V_START - LAG;

	reg [12:0]   hcnt;
	reg [9:0]    vcnt;
	reg          frame_pending;
	reg [SW-1:0] base_pend, base;
	reg [1:0]    no_frame;           // output frames without source frame

	initial resync_toggle = 0;

	wire [9:0] vcnt_next = (vcnt == OUT_V_TOTAL - 1) ? 10'd0 : vcnt + 1'b1;

	always @(posedge clk_out) begin
		if (!resetn_out) begin
			hcnt          <= 0;
			vcnt          <= 0;
			frame_pending <= 0;
			base_pend     <= 0;
			base          <= 0;
			no_frame      <= 2'd3;
		end else begin
			if (hcnt == OUT_H_TOTAL - 1) begin
				hcnt <= 0;
				if (frame_pending) begin
					// output line OUT_V_START starts LAG lines from now
					frame_pending <= 0;
					base          <= base_pend;
					no_frame      <= 0;
					vcnt          <= V_JUMP;
					if (vcnt_next != V_JUMP)
						resync_toggle <= !resync_toggle;
				end else begin
					vcnt <= vcnt_next;
					if (vcnt == OUT_V_TOTAL - 1 && !(&no_frame))
						no_frame <= no_frame + 1'b1;
				end
			end else begin
				hcnt <= hcnt + 1'b1;
			end

			if (frame_evt) begin
				frame_pending <= 1;
				base_pend     <= fr_base;
			end
		end
	end

	// stage 1: address and timing
	wire [9:0]  y = vcnt - OUT_V_START;
	wire [12:0] x = hcnt - OUT_H_START;

	wire act_v = vcnt >= OUT_V_START && vcnt < OUT_V_START + V_ACTIVE;
	wire act_h = hcnt >= OUT_H_START && hcnt < OUT_H_START + H_ACTIVE;

	wire [SW-1:0] rd_slot = base + y[SW-1:0];

	reg [SW+AW-1:0] rd_addr;
	reg             de_p1, hs_p1, vs_p1, ok_p1;

	// slot_valid comes from the pclk domain; the bit read here was written
	// several lines earlier and is stable
	always @(posedge clk_out) begin
		rd_addr <= {rd_slot, x[AW-1:0]};
		de_p1   <= act_v && act_h;
		ok_p1   <= no_frame < 2 && slot_valid[rd_slot];
		hs_p1   <= hcnt < OUT_HS_WIDTH;
		vs_p1   <= vcnt < OUT_VS_LINES;
	end

	// stage 2: buffer read
	reg [23:0] rd_data;
	reg        de_p2, hs_p2, vs_p2, ok_p2;

	always @(posedge clk_out) begin
		rd_data <= line_mem[rd_addr];
		de_p2   <= de_p1;
		ok_p2   <= ok_p1;
		hs_p2   <= hs_p1;
		vs_p2   <= vs_p1;
	end

	// stage 3: output registers, apply sync polarity
	always @(posedge clk_out) begin
		rgb_out <= (de_p2 && ok_p2) ? rd_data : 24'd0;
		de_out  <= de_p2;
		hs_out  <= hs_p2 ^ (HS_ACTIVE_LOW != 0);
		vs_out  <= vs_p2 ^ (VS_ACTIVE_LOW != 0);
	end

endmodule

`default_nettype wire
